// Copyright 2021 Manna Harbour
// https://github.com/manna-harbour/miryoku

#include "../miryoku/custom_config.h"
// #include "../miryoku/mapping/58/lily58.h"
#include "../miryoku/mapping/58/tiev_lily58.h"
#include "../miryoku/miryoku.dtsi"
