// Copyright 2021 Manna Harbour
// https://github.com/manna-harbour/miryoku

#include "../miryoku/custom_config.h"
// #include "../miryoku/mapping/44/technikable.h"
#include "../miryoku/mapping/44/tiev_technikable.h"
#include "../miryoku/miryoku.dtsi"
